## KSZ/Atmel_SOC_SAMA5D3/buildroot/configs/atmel_sama5d3_xplained_ksz9897_defconfig
```kconfig
BR2_arm=y
BR2_cortex_a5=y
BR2_ARM_ENABLE_VFP=y
BR2_ARM_INSTRUCTIONS_THUMB2=y
BR2_DL_DIR="../dl"
BR2_PACKAGE_HOST_LINUX_HEADERS_CUSTOM_3_18=y
BR2_ROOTFS_OVERLAY="board/atmel/sama5d3_xplained_ksz9897/rootfs_overlay"
BR2_ROOTFS_POST_BUILD_SCRIPT="board/atmel/sama5d3_xplained_ksz9897/post-build.sh"
BR2_ROOTFS_POST_IMAGE_SCRIPT="board/atmel/sama5d3_xplained_ksz9897/post-image.sh"
BR2_LINUX_KERNEL=y
BR2_LINUX_KERNEL_CUSTOM_LOCAL=y
BR2_LINUX_KERNEL_CUSTOM_LOCAL_PATH="$(KSZ_HOME)/kernels/linux-3.18"
BR2_LINUX_KERNEL_USE_CUSTOM_CONFIG=y
BR2_LINUX_KERNEL_CUSTOM_CONFIG_FILE="$(KSZ_HOME)/kernels/linux-3.18/arch/arm/configs/sama5_ksz9897_defconfig"
BR2_LINUX_KERNEL_DTS_SUPPORT=y
BR2_LINUX_KERNEL_INTREE_DTS_NAME="at91-sama5d3_xplained_ksz9897"
BR2_PACKAGE_BUSYBOX_CONFIG="board/atmel/sama5d3_xplained_ksz9897/busybox.config"
BR2_PACKAGE_BRIDGE_UTILS=y
BR2_PACKAGE_ETHTOOL=y
BR2_PACKAGE_IPERF3=y
BR2_PACKAGE_NUTTCP=y
BR2_PACKAGE_KSZ_PTP_CLI=y
BR2_PACKAGE_KSZ_OPENAVB=y
BR2_TARGET_ROOTFS_UBIFS=y
BR2_TARGET_ROOTFS_UBIFS_LEBSIZE=0x1f000
BR2_TARGET_ROOTFS_UBI=y
BR2_TARGET_ROOTFS_UBI_SUBSIZE=2048
BR2_TARGET_AT91BOOTSTRAP3=y
BR2_TARGET_AT91BOOTSTRAP3_CUSTOM_GIT=y
BR2_TARGET_AT91BOOTSTRAP3_CUSTOM_REPO_URL="https://github.com/linux4sam/at91bootstrap.git"
BR2_TARGET_AT91BOOTSTRAP3_CUSTOM_REPO_VERSION="v3.8.5"
BR2_TARGET_AT91BOOTSTRAP3_DEFCONFIG="sama5d3_xplainednf_uboot"
BR2_TARGET_UBOOT=y
BR2_TARGET_UBOOT_BUILD_SYSTEM_KCONFIG=y
BR2_TARGET_UBOOT_CUSTOM_GIT=y
BR2_TARGET_UBOOT_CUSTOM_REPO_URL="https://github.com/linux4sam/u-boot-at91.git"
BR2_TARGET_UBOOT_CUSTOM_REPO_VERSION="linux4sam_5.3"
BR2_TARGET_UBOOT_PATCH="../patches/uboot-linux4sam_5.3"
BR2_TARGET_UBOOT_BOARD_DEFCONFIG="sama5d3_xplained_ksz9897"
BR2_TARGET_UBOOT_ENV=y
BR2_PACKAGE_HOST_SAM_BA=y
```

## KSZ/Atmel_SOC_SAMA5D3/buildroot/configs/atmel_sama5d3_xplained_ksz_5_15_mmc_defconfig
```kconfig
BR2_arm=y
BR2_cortex_a5=y
BR2_ARM_ENABLE_VFP=y
BR2_ARM_INSTRUCTIONS_THUMB2=y
BR2_DL_DIR="$(TOPDIR)/../dl"
BR2_PACKAGE_HOST_LINUX_HEADERS_CUSTOM_5_15=y
BR2_GCC_VERSION_6_X=y
BR2_TOOLCHAIN_BUILDROOT_CXX=y
BR2_ROOTFS_OVERLAY="board/atmel/sama5d3_xplained_ksz9897/rootfs_overlay"
BR2_ROOTFS_POST_BUILD_SCRIPT="board/atmel/sama5d3_xplained_ksz9897/post-build.sh"
BR2_ROOTFS_POST_IMAGE_SCRIPT="board/atmel/sama5d3_xplained_ksz9897/post-mmc-image.sh"
BR2_LINUX_KERNEL=y
BR2_LINUX_KERNEL_CUSTOM_TARBALL=y
BR2_LINUX_KERNEL_CUSTOM_TARBALL_LOCATION="$(call github,linux4microchip,linux,linux4microchip-2022.04)/linux-linux4microchip-2022.04.tar.gz"
BR2_LINUX_KERNEL_PATCH="../patches/linux-linux4microchip-2022.04"
BR2_LINUX_KERNEL_DEFCONFIG="sama5_ksz"
BR2_LINUX_KERNEL_DTS_SUPPORT=y
BR2_LINUX_KERNEL_INTREE_DTS_NAME="at91-sama5d3_xplained_ung8071"
BR2_PACKAGE_BUSYBOX_CONFIG="board/atmel/sama5d3_xplained_ksz9897/busybox.config"
BR2_PACKAGE_DOSFSTOOLS=y
BR2_PACKAGE_DOSFSTOOLS_FSCK_FAT=y
BR2_PACKAGE_E2FSPROGS=y
BR2_PACKAGE_BRIDGE_UTILS=y
BR2_PACKAGE_ETHTOOL=y
BR2_PACKAGE_IPERF=y
BR2_PACKAGE_IPERF3=y
BR2_PACKAGE_IPROUTE2=y
BR2_PACKAGE_NUTTCP=y
BR2_PACKAGE_TCPDUMP=y
BR2_PACKAGE_KSZ_PTP_CLI=y
BR2_PACKAGE_KSZ_OPENAVB=y
BR2_TARGET_ROOTFS_EXT2=y
BR2_TARGET_ROOTFS_EXT2_4=y
BR2_TARGET_ROOTFS_EXT2_EXTRA_BLOCKS=220000
BR2_TARGET_ROOTFS_EXT2_EXTRA_INODES=65000
BR2_TARGET_AT91BOOTSTRAP3=y
BR2_TARGET_AT91BOOTSTRAP3_CUSTOM_GIT=y
BR2_TARGET_AT91BOOTSTRAP3_CUSTOM_REPO_URL="https://github.com/linux4sam/at91bootstrap.git"
BR2_TARGET_AT91BOOTSTRAP3_CUSTOM_REPO_VERSION="v3.8.5"
BR2_TARGET_AT91BOOTSTRAP3_DEFCONFIG="sama5d3_xplainedsd_uboot"
BR2_TARGET_UBOOT=y
BR2_TARGET_UBOOT_BUILD_SYSTEM_KCONFIG=y
BR2_TARGET_UBOOT_CUSTOM_TARBALL=y
BR2_TARGET_UBOOT_CUSTOM_TARBALL_LOCATION="$(call github,linux4sam,u-boot-at91,linux4sam-2020.10.1)/u-boot-at91-linux4sam-2020.10.1.tar.gz"
BR2_TARGET_UBOOT_PATCH="../patches/u-boot-at91-linux4sam-2020.10.1"
BR2_TARGET_UBOOT_BOARD_DEFCONFIG="sama5d3_xplained_ung8071_mmc"
BR2_TARGET_UBOOT_ENVTOOLS=y
BR2_PACKAGE_HOST_DOSFSTOOLS=y
BR2_PACKAGE_HOST_GENIMAGE=y
BR2_PACKAGE_HOST_MTOOLS=y
```

## KSZ/Atmel_SOC_SAMA5D3/buildroot/package/microchip/Config.in
```kconfig
source "package/microchip/ksz_linuxptp/Config.in"
source "package/microchip/ksz_linuxptp-3.1.1/Config.in"
source "package/microchip/ksz_linuxptp-4.0.0/Config.in"
source "package/microchip/ksz_ptp_scripts/Config.in"
source "package/microchip/ksz_regs_bin/Config.in"
source "package/microchip/ksz_ptp_cli/Config.in"
source "package/microchip/ksz_ptp_test/Config.in"
source "package/microchip/ksz_OpenAVB/Config.in"
source "package/microchip/mdio-tool/Config.in"
source "package/microchip/web_gui/Config.in"
source "package/microchip/ksz_lan8770_app/Config.in"
```

## KSZ/Atmel_SOC_SAMA5D3/buildroot/package/microchip/ksz_OpenAVB/Config.in
```kconfig
config BR2_PACKAGE_KSZ_OPENAVB
	bool "OpenAVB"
	select BR2_PACKAGE_KSZ_PTP_SCRIPTS
	help
	  The OpenAVB includes daemons like mrpd for Multiple Registration
	  Protocol and simple AVB test utilities.
```

## KSZ/Atmel_SOC_SAMA5D3/buildroot/package/microchip/ksz_lan8770_app/Config.in
```kconfig
config BR2_PACKAGE_KSZ_LAN8770_APP
	bool "Microchip lan87700_app"
	select BR2_PACKAGE_LIBMNL
	default y
	help
	  Microchip lan8770 utility for cable diag and tc10.

	  This package builds and installs the userspace 'lan8770_app'
	  command. It is up to the user to ensure that the kernel
	  configuration has all suitable options enabled to allow a
	  proper operation of 'lan8770_app'.
```

## KSZ/Atmel_SOC_SAMA5D3/buildroot/package/microchip/ksz_linuxptp-4.0.0/Config.in
```kconfig
config BR2_PACKAGE_KSZ_LINUXPTP_4_0_0
	bool "Linux PTP 4.0.0"
	default y
	select BR2_PACKAGE_KSZ_PTP_SCRIPTS
	help
	  The Linux PTP daemon (ptp4l) implements the Precision Time protocol
	  (PTP) as defined by the IEEE-1588-2002.
```

## KSZ/Atmel_SOC_SAMA5D3/buildroot/package/microchip/ksz_linuxptp/Config.in
```kconfig
config BR2_PACKAGE_KSZ_LINUXPTP
	bool "Linux PTP"
	default y
	select BR2_PACKAGE_KSZ_PTP_SCRIPTS
	help
	  The Linux PTP daemon (ptp4l) implements the Precision Time protocol
	  (PTP) as defined by the IEEE-1588-2002.
```

## KSZ/Atmel_SOC_SAMA5D3/buildroot/package/microchip/ksz_ptp_cli/Config.in
```kconfig
config BR2_PACKAGE_KSZ_PTP_CLI
	bool "Microchip PTP CLI"
	help
	  Microchip PTP CLI utility.

	  This package builds and installs the userspace 'ptp_cli'
	  command. It is up to the user to ensure that the kernel
	  configuration has all suitable options enabled to allow a
	  proper operation of 'ptp_cli'.
```

## KSZ/Atmel_SOC_SAMA5D3/buildroot/package/microchip/ksz_ptp_scripts/Config.in
```kconfig
config BR2_PACKAGE_KSZ_PTP_SCRIPTS
	bool "PTP scripts"
	default y
	help
	  PTP scripts for use with trying different PTP profiles.
```

## KSZ/Atmel_SOC_SAMA5D3/buildroot/package/microchip/ksz_ptp_test/Config.in
```kconfig
config BR2_PACKAGE_KSZ_PTP_TEST
	bool "Microchip PTP Test"
	default y
	help
	  Microchip PTP test utility.

	  This package builds and installs the userspace 'ptp'
	  command. It is up to the user to ensure that the kernel
	  configuration has all suitable options enabled to allow a
	  proper operation of 'ptp'.
```

## KSZ/Atmel_SOC_SAMA5D3/buildroot/package/microchip/ksz_regs_bin/Config.in
```kconfig
config BR2_PACKAGE_KSZ_REGS_BIN
	bool "Microchip regs_bin"
	default y
	help
	  Microchip register access utility.

	  This package builds and installs the userspace 'regs_bin'
	  command. It is up to the user to ensure that the kernel
	  configuration has all suitable options enabled to allow a
	  proper operation of 'regs_bin'.
```

## KSZ/Atmel_SOC_SAMA5D3/buildroot/package/microchip/mdio-tool/Config.in
```kconfig
config BR2_PACKAGE_MDIO_TOOL
	bool "Customized mdio-tool"
	default y
	help
	  Microchip phy register access utility.

	  This package builds and installs the userspace 'mdio-tool'
	  command. It is up to the user to ensure that the kernel
	  configuration has all suitable options enabled to allow a
	  proper operation of 'mdio-tool'.
```

## KSZ/Atmel_SOC_SAMA5D3/buildroot/package/microchip/web_gui/Config.in
```kconfig
config BR2_PACKAGE_WEB_GUI
	bool "WEB GUI"
	default y
	select BR2_TOOLCHAIN_BUILDROOT_WCHAR
	select BR2_PACKAGE_PYTHON
	select BR2_PACKAGE_THTTPD
	help
	  WEB GUI Configuration utility.

	  This package builds and installs the web packages.
	  It is up to the user to ensure that the kernel
	  configuration has all suitable options enabled to allow a
	  proper operation of web gui.
```

## KSZ/kernels/linux-3.18/arch/arm/configs/ks8695v_base_defconfig
```kconfig
# CONFIG_ARM_PATCH_PHYS_VIRT is not set
CONFIG_CROSS_COMPILE="arm-none-linux-gnueabi-"
CONFIG_LOCALVERSION="-Centaur"
# CONFIG_LOCALVERSION_AUTO is not set
# CONFIG_SWAP is not set
CONFIG_SYSVIPC=y
# CONFIG_CROSS_MEMORY_ATTACH is not set
CONFIG_IKCONFIG=y
CONFIG_IKCONFIG_PROC=y
CONFIG_LOG_BUF_SHIFT=14
CONFIG_BLK_DEV_INITRD=y
CONFIG_SYSCTL_SYSCALL=y
# CONFIG_KALLSYMS is not set
# CONFIG_AIO is not set
# CONFIG_PCI_QUIRKS is not set
CONFIG_EMBEDDED=y
# CONFIG_VM_EVENT_COUNTERS is not set
# CONFIG_COMPAT_BRK is not set
CONFIG_SLAB=y
CONFIG_JUMP_LABEL=y
CONFIG_MODULES=y
CONFIG_MODULE_UNLOAD=y
CONFIG_MODULE_FORCE_UNLOAD=y
# CONFIG_LBDAF is not set
# CONFIG_BLK_DEV_BSG is not set
CONFIG_PARTITION_ADVANCED=y
# CONFIG_EFI_PARTITION is not set
# CONFIG_IOSCHED_CFQ is not set
CONFIG_ARCH_MICREL_CENTAUR=y
CONFIG_ARCH_KS8695V=y
CONFIG_U_BOOT_LOADER=y
CONFIG_CENTAUR_LOADER_SIZE=0x30000
CONFIG_CENTAUR_FS_SIZE=0xA0000
# CONFIG_ARM_THUMB is not set
CONFIG_PCI=y
CONFIG_AEABI=y
# CONFIG_COMPACTION is not set
CONFIG_ZBOOT_ROM_TEXT=0x0
CONFIG_ZBOOT_ROM_BSS=0x0
CONFIG_CMDLINE="console=ttyS0,115200 init=/etc/preinit"
# CONFIG_CORE_DUMP_DEFAULT_ELF_HEADERS is not set
CONFIG_NET=y
CONFIG_PACKET=y
CONFIG_UNIX=y
CONFIG_INET=y
CONFIG_IP_MULTICAST=y
CONFIG_IP_ADVANCED_ROUTER=y
CONFIG_IP_ROUTE_VERBOSE=y
# CONFIG_INET_XFRM_MODE_TRANSPORT is not set
# CONFIG_INET_XFRM_MODE_TUNNEL is not set
# CONFIG_INET_XFRM_MODE_BEET is not set
# CONFIG_INET_LRO is not set
CONFIG_IPV6=y
# CONFIG_INET6_XFRM_MODE_TRANSPORT is not set
# CONFIG_INET6_XFRM_MODE_TUNNEL is not set
# CONFIG_INET6_XFRM_MODE_BEET is not set
# CONFIG_IPV6_SIT is not set
CONFIG_BRIDGE=y
# CONFIG_WIRELESS is not set
CONFIG_UEVENT_HELPER_PATH="/sbin/hotplug"
# CONFIG_STANDALONE is not set
# CONFIG_FW_LOADER is not set
CONFIG_MTD=y
CONFIG_MTD_CFI=y
CONFIG_MTD_CFI_AMDSTD=y
CONFIG_MTD_PHYSMAP=y
CONFIG_MTD_PHYSMAP_COMPAT=y
CONFIG_MTD_PHYSMAP_START=0x2000000
CONFIG_MTD_PHYSMAP_LEN=0x400000
CONFIG_BLK_DEV_RAM=y
CONFIG_BLK_DEV_RAM_SIZE=8192
CONFIG_NETDEVICES=y
# CONFIG_NET_VENDOR_3COM is not set
CONFIG_NET_CENTAUR=y
CONFIG_PPP=m
CONFIG_PPP_FILTER=y
CONFIG_PPPOE=m
# CONFIG_WLAN is not set
# CONFIG_INPUT is not set
# CONFIG_SERIO is not set
# CONFIG_VT is not set
# CONFIG_LEGACY_PTYS is not set
# CONFIG_DEVKMEM is not set
# CONFIG_HW_RANDOM is not set
# CONFIG_HWMON is not set
CONFIG_WATCHDOG=y
CONFIG_MICREL_WATCHDOG=y
# CONFIG_VGA_ARB is not set
# CONFIG_USB_SUPPORT is not set
# CONFIG_IOMMU_SUPPORT is not set
CONFIG_EXT2_FS=y
CONFIG_EXT3_FS=m
# CONFIG_EXT3_DEFAULTS_TO_ORDERED is not set
CONFIG_EXT4_FS=y
# CONFIG_DNOTIFY is not set
CONFIG_VFAT_FS=y
CONFIG_NTFS_FS=y
# CONFIG_PROC_PAGE_MONITOR is not set
CONFIG_TMPFS=y
CONFIG_JFFS2_FS=y
CONFIG_NFS_FS=y
CONFIG_NLS_CODEPAGE_437=m
CONFIG_NLS_ISO8859_1=m
CONFIG_DYNAMIC_DEBUG=y
CONFIG_DEBUG_FS=y
# CONFIG_FTRACE is not set
```

## KSZ/kernels/linux-3.18/arch/arm/configs/ksz9692_defconfig
```kconfig
# CONFIG_ARM_PATCH_PHYS_VIRT is not set
CONFIG_CROSS_COMPILE="arm-none-linux-gnueabi-"
CONFIG_LOCALVERSION="-Pegasus"
# CONFIG_LOCALVERSION_AUTO is not set
# CONFIG_SWAP is not set
CONFIG_SYSVIPC=y
# CONFIG_CROSS_MEMORY_ATTACH is not set
CONFIG_NO_HZ=y
CONFIG_IKCONFIG=y
CONFIG_IKCONFIG_PROC=y
CONFIG_LOG_BUF_SHIFT=14
CONFIG_BLK_DEV_INITRD=y
CONFIG_SYSCTL_SYSCALL=y
# CONFIG_KALLSYMS is not set
# CONFIG_AIO is not set
# CONFIG_PCI_QUIRKS is not set
CONFIG_EMBEDDED=y
# CONFIG_VM_EVENT_COUNTERS is not set
# CONFIG_COMPAT_BRK is not set
CONFIG_SLAB=y
CONFIG_JUMP_LABEL=y
CONFIG_MODULES=y
CONFIG_MODULE_UNLOAD=y
CONFIG_MODULE_FORCE_UNLOAD=y
# CONFIG_LBDAF is not set
# CONFIG_BLK_DEV_BSG is not set
CONFIG_PARTITION_ADVANCED=y
# CONFIG_EFI_PARTITION is not set
# CONFIG_IOSCHED_CFQ is not set
CONFIG_ARCH_MICREL_PEGASUS=y
CONFIG_CENTAUR_LOADER_SIZE=0x40000
CONFIG_CENTAUR_KERNEL_SIZE=0x180000
CONFIG_CENTAUR_FS_SIZE=0xA0000
# CONFIG_ARM_THUMB is not set
CONFIG_PCI=y
CONFIG_AEABI=y
# CONFIG_COMPACTION is not set
CONFIG_ZBOOT_ROM_TEXT=0x0
CONFIG_ZBOOT_ROM_BSS=0x0
CONFIG_CMDLINE="console=ttyS0,115200 init=/etc/preinit"
# CONFIG_CORE_DUMP_DEFAULT_ELF_HEADERS is not set
CONFIG_NET=y
CONFIG_PACKET=y
CONFIG_UNIX=y
CONFIG_INET=y
CONFIG_IP_MULTICAST=y
CONFIG_IP_ADVANCED_ROUTER=y
CONFIG_IP_ROUTE_VERBOSE=y
# CONFIG_INET_XFRM_MODE_TRANSPORT is not set
# CONFIG_INET_XFRM_MODE_TUNNEL is not set
# CONFIG_INET_XFRM_MODE_BEET is not set
# CONFIG_INET_LRO is not set
CONFIG_IPV6=y
# CONFIG_INET6_XFRM_MODE_TRANSPORT is not set
# CONFIG_INET6_XFRM_MODE_TUNNEL is not set
# CONFIG_INET6_XFRM_MODE_BEET is not set
# CONFIG_IPV6_SIT is not set
CONFIG_NETFILTER=y
CONFIG_NF_CONNTRACK=y
CONFIG_NF_CONNTRACK_FTP=y
CONFIG_NETFILTER_XT_TARGET_MARK=y
CONFIG_NETFILTER_XT_TARGET_TCPMSS=y
CONFIG_NETFILTER_XT_MATCH_CONNTRACK=y
CONFIG_NETFILTER_XT_MATCH_LENGTH=y
CONFIG_NETFILTER_XT_MATCH_LIMIT=y
CONFIG_NETFILTER_XT_MATCH_MAC=y
CONFIG_NETFILTER_XT_MATCH_MARK=y
CONFIG_NETFILTER_XT_MATCH_MULTIPORT=y
CONFIG_NETFILTER_XT_MATCH_PKTTYPE=y
CONFIG_NETFILTER_XT_MATCH_STATE=y
CONFIG_NETFILTER_XT_MATCH_TCPMSS=y
CONFIG_NF_CONNTRACK_IPV4=y
CONFIG_IP_NF_IPTABLES=y
CONFIG_IP_NF_MATCH_TTL=y
CONFIG_IP_NF_FILTER=y
CONFIG_IP_NF_TARGET_REJECT=y
CONFIG_IP_NF_MANGLE=y
CONFIG_BRIDGE=y
CONFIG_VLAN_8021Q=y
CONFIG_UEVENT_HELPER_PATH="/sbin/hotplug"
# CONFIG_STANDALONE is not set
# CONFIG_FW_LOADER is not set
CONFIG_MTD=y
CONFIG_MTD_CMDLINE_PARTS=y
CONFIG_MTD_BLOCK=y
CONFIG_MTD_CFI=y
CONFIG_MTD_CFI_AMDSTD=y
CONFIG_MTD_PHYSMAP=y
CONFIG_BLK_DEV_RAM=y
CONFIG_BLK_DEV_RAM_SIZE=16384
CONFIG_SCSI=y
CONFIG_BLK_DEV_SD=y
# CONFIG_SCSI_LOWLEVEL is not set
CONFIG_NETDEVICES=y
# CONFIG_NET_VENDOR_3COM is not set
CONFIG_NET_PEGASUS=y
CONFIG_MICREL_PHY=y
CONFIG_PPP=m
CONFIG_PPP_FILTER=y
CONFIG_PPPOE=m
# CONFIG_INPUT is not set
# CONFIG_SERIO is not set
# CONFIG_VT is not set
# CONFIG_LEGACY_PTYS is not set
# CONFIG_DEVKMEM is not set
# CONFIG_HW_RANDOM is not set
CONFIG_I2C=y
CONFIG_I2C_CHARDEV=y
CONFIG_I2C_PEGASUS=y
CONFIG_SPI=y
# CONFIG_HWMON is not set
CONFIG_WATCHDOG=y
CONFIG_MICREL_WATCHDOG=y
# CONFIG_VGA_ARB is not set
CONFIG_USB=y
CONFIG_USB_MON=y
CONFIG_USB_EHCI_HCD=y
# CONFIG_USB_EHCI_TT_NEWSCHED is not set
CONFIG_USB_OHCI_HCD=y
CONFIG_USB_UHCI_HCD=y
CONFIG_USB_STORAGE=y
CONFIG_MMC=y
CONFIG_MMC_SDHCI=y
CONFIG_MMC_SDHCI_PEGASUS=y
CONFIG_NEW_LEDS=y
CONFIG_LEDS_CLASS=y
CONFIG_LEDS_TRIGGERS=y
CONFIG_LEDS_TRIGGER_HEARTBEAT=y
CONFIG_LEDS_TRIGGER_CPU=y
# CONFIG_IOMMU_SUPPORT is not set
CONFIG_EXT2_FS=y
CONFIG_EXT3_FS=y
# CONFIG_EXT3_DEFAULTS_TO_ORDERED is not set
CONFIG_EXT4_FS=y
# CONFIG_DNOTIFY is not set
CONFIG_VFAT_FS=y
CONFIG_NTFS_FS=y
# CONFIG_PROC_PAGE_MONITOR is not set
CONFIG_TMPFS=y
CONFIG_JFFS2_FS=y
CONFIG_NFS_FS=y
CONFIG_NLS_CODEPAGE_437=y
CONFIG_NLS_ISO8859_1=y
CONFIG_DYNAMIC_DEBUG=y
CONFIG_DEBUG_FS=y
# CONFIG_FTRACE is not set
# CONFIG_CRYPTO_ANSI_CPRNG is not set
```
