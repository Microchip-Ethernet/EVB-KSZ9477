## KSZ/kernels/linux-3.18/arch/arm/configs/ksz9692_ksz8863_defconfig
```kconfig
# CONFIG_ARM_PATCH_PHYS_VIRT is not set
CONFIG_CROSS_COMPILE="arm-none-linux-gnueabi-"
CONFIG_LOCALVERSION="-Pegasus"
# CONFIG_LOCALVERSION_AUTO is not set
# CONFIG_SWAP is not set
CONFIG_SYSVIPC=y
# CONFIG_CROSS_MEMORY_ATTACH is not set
CONFIG_NO_HZ=y
CONFIG_IKCONFIG=y
CONFIG_IKCONFIG_PROC=y
CONFIG_LOG_BUF_SHIFT=14
CONFIG_BLK_DEV_INITRD=y
CONFIG_SYSCTL_SYSCALL=y
# CONFIG_KALLSYMS is not set
# CONFIG_AIO is not set
CONFIG_EMBEDDED=y
# CONFIG_VM_EVENT_COUNTERS is not set
# CONFIG_COMPAT_BRK is not set
CONFIG_SLAB=y
CONFIG_JUMP_LABEL=y
CONFIG_MODULES=y
CONFIG_MODULE_UNLOAD=y
CONFIG_MODULE_FORCE_UNLOAD=y
# CONFIG_LBDAF is not set
# CONFIG_BLK_DEV_BSG is not set
CONFIG_PARTITION_ADVANCED=y
# CONFIG_EFI_PARTITION is not set
# CONFIG_IOSCHED_CFQ is not set
CONFIG_ARCH_MICREL_PEGASUS=y
CONFIG_CENTAUR_LOADER_SIZE=0x40000
CONFIG_CENTAUR_KERNEL_SIZE=0x180000
CONFIG_CENTAUR_FS_SIZE=0xA0000
CONFIG_CONSOLE_PORT=2
# CONFIG_ARM_THUMB is not set
CONFIG_AEABI=y
CONFIG_OABI_COMPAT=y
# CONFIG_COMPACTION is not set
CONFIG_ZBOOT_ROM_TEXT=0x0
CONFIG_ZBOOT_ROM_BSS=0x0
CONFIG_CMDLINE="console=ttyS2,115200 init=/etc/preinit ksz8692.wan_multi_dev=1"
CONFIG_FPE_NWFPE=y
# CONFIG_CORE_DUMP_DEFAULT_ELF_HEADERS is not set
CONFIG_NET=y
CONFIG_PACKET=y
CONFIG_UNIX=y
CONFIG_INET=y
CONFIG_IP_MULTICAST=y
CONFIG_IP_ADVANCED_ROUTER=y
CONFIG_IP_ROUTE_VERBOSE=y
# CONFIG_INET_XFRM_MODE_TRANSPORT is not set
# CONFIG_INET_XFRM_MODE_TUNNEL is not set
# CONFIG_INET_XFRM_MODE_BEET is not set
# CONFIG_INET_LRO is not set
CONFIG_IPV6=y
# CONFIG_INET6_XFRM_MODE_TRANSPORT is not set
# CONFIG_INET6_XFRM_MODE_TUNNEL is not set
# CONFIG_INET6_XFRM_MODE_BEET is not set
# CONFIG_IPV6_SIT is not set
CONFIG_BRIDGE=y
CONFIG_VLAN_8021Q=y
# CONFIG_WIRELESS is not set
CONFIG_UEVENT_HELPER_PATH="/sbin/hotplug"
# CONFIG_STANDALONE is not set
# CONFIG_FW_LOADER is not set
CONFIG_MTD=y
CONFIG_MTD_CMDLINE_PARTS=y
CONFIG_MTD_BLOCK=y
CONFIG_MTD_CFI=y
CONFIG_MTD_CFI_AMDSTD=y
CONFIG_MTD_PHYSMAP=y
CONFIG_BLK_DEV_RAM=y
CONFIG_BLK_DEV_RAM_SIZE=8192
CONFIG_SCSI=y
CONFIG_BLK_DEV_SD=y
# CONFIG_SCSI_LOWLEVEL is not set
CONFIG_NETDEVICES=y
CONFIG_NET_PEGASUS=y
CONFIG_KSZ_SWITCHES=y
CONFIG_KSZ8863_EMBEDDED=y
CONFIG_MICREL_PHY=y
CONFIG_PPP=m
CONFIG_PPP_FILTER=y
CONFIG_PPPOE=m
# CONFIG_WLAN is not set
# CONFIG_INPUT is not set
# CONFIG_SERIO is not set
# CONFIG_VT is not set
# CONFIG_LEGACY_PTYS is not set
# CONFIG_DEVKMEM is not set
# CONFIG_HW_RANDOM is not set
CONFIG_I2C=y
CONFIG_I2C_CHARDEV=y
CONFIG_I2C_PEGASUS=y
CONFIG_SPI=y
# CONFIG_SPI_FTDI is not set
# CONFIG_HWMON is not set
CONFIG_WATCHDOG=y
CONFIG_MICREL_WATCHDOG=y
CONFIG_USB=y
CONFIG_USB_MON=y
CONFIG_USB_EHCI_HCD=y
# CONFIG_USB_EHCI_TT_NEWSCHED is not set
CONFIG_USB_OHCI_HCD=y
CONFIG_USB_STORAGE=y
CONFIG_MMC=y
CONFIG_MMC_SDHCI=y
CONFIG_MMC_SDHCI_PEGASUS=y
CONFIG_NEW_LEDS=y
CONFIG_LEDS_CLASS=y
CONFIG_LEDS_TRIGGERS=y
CONFIG_LEDS_TRIGGER_HEARTBEAT=y
CONFIG_LEDS_TRIGGER_CPU=y
# CONFIG_IOMMU_SUPPORT is not set
CONFIG_EXT2_FS=y
CONFIG_EXT3_FS=y
# CONFIG_EXT3_DEFAULTS_TO_ORDERED is not set
# CONFIG_DNOTIFY is not set
CONFIG_VFAT_FS=y
CONFIG_NTFS_FS=y
# CONFIG_PROC_PAGE_MONITOR is not set
CONFIG_TMPFS=y
CONFIG_JFFS2_FS=y
CONFIG_NFS_FS=y
CONFIG_NLS_CODEPAGE_437=y
CONFIG_NLS_ISO8859_1=y
CONFIG_DYNAMIC_DEBUG=y
CONFIG_DEBUG_FS=y
# CONFIG_FTRACE is not set
```

## KSZ/kernels/linux-3.18/arch/arm/mach-ksz8692/Kconfig
```kconfig
choice
	prompt "Micrel Pegasus Implementations"
	depends on ARCH_MICREL_PEGASUS
	default ARCH_KS8692P

config ARCH_KS8692P
	bool "KSZ8692P"
	select KS8692P
	help
	  Include support for KSZ8692P SoC platforms.

endchoice

config KS8692P
	bool
	help
	  KSZ8692P-based chip support.

choice
	prompt "KSZ8692P Revisions"
	depends on ARCH_KS8692P
	default KSZ8692VB

config KSZ8692VB
	bool "KSZ8692 Rev. B"
	help
	  Support for first revision KSZ8692P platforms.
endchoice

config KSZ8692_MII
	bool "Use MII mode"
	depends on NET_PEGASUS
	help
	  Use MII mode instead of RGMII.

config PEGASUS_WAN_ONLY
	bool
	depends on NET_PEGASUS
	default n
	help
	  LAN port is used for some other device.

config PEGASUS_LAN_SPECIAL
	bool
	depends on NET_PEGASUS
	default n
	help
	  LAN port is connected to some other device.

config PEGASUS_NO_MDIO
	bool
	depends on NET_PEGASUS
	default n
	help
	  WAN port is not connected to PHY.

config PEGASUS_NO_PCI
	bool
	depends on KSZ8692VB
	default n
	help
	  PCI is disabled.

config KSZ8462_HLI_EXT
	bool
	default n
	depends on ARCH_MICREL_PEGASUS
	help
	  Support for KSZ8462-HLI chip on external bus.

config SPECIAL_BOARD
	bool "Special Board"
	depends on KSZ8692VB
	select PEGASUS_NO_PCI
	---help---
	  Special boards do not have PCI support.

choice
	prompt "Board types"
	depends on SPECIAL_BOARD
	default KSZ_CTRL_BOARD

config KSZ_CTRL_BOARD
	bool "Micrel Control Board"
	select PEGASUS_WAN_ONLY if NET_PEGASUS
	select PEGASUS_NO_MDIO if NET_PEGASUS
	---help---
	  Supports the Micrel Control Board.

config KSZ_CTRL_MII_BOARD
	bool "Micrel Control Board with MII"
	---help---
	  Supports the Micrel Control Board with MII extension.

config MICREL_FPGA_BOARD
	bool "Micrel FPGA Board"
	select PEGASUS_LAN_SPECIAL if NET_PEGASUS
	---help---
	  Supports the Micrel FPGA Board.
endchoice

config CONSOLE_PORT
	int "Console port"
	default "0"
	depends on ARCH_MICREL_PEGASUS
	help
	  Change default console port.

config DELAYED_TIMER
	bool "Enable delayed timer"
	default n
	depends on ARCH_MICREL_PEGASUS
	help
	  Enable microsecond timer for delayed tasks.

config U_BOOT_LOADER
	bool "Use U-Boot loader"
	default y
	depends on ARCH_MICREL_PEGASUS
	help
	  Use U-Boot loader.

config CENTAUR_LOADER_SIZE
	hex "Bootloader size"
	depends on ARCH_MICREL_PEGASUS
	default "0x10000"
	help
	  This is the maximum size of the bootloader for the Pegasus
	  chips.

config CENTAUR_KERNEL_SIZE
	hex "Kernel size"
	depends on ARCH_MICREL_PEGASUS
	default "0xE0000"
	help
	  This is the maximum size of the kernel for the Pegasus
	  chips.

config CENTAUR_FS_SIZE
	hex "Filesystem size"
	depends on ARCH_MICREL_PEGASUS
	default "0x60000"
	help
	  This is the size of the non-volatile filesystem for the
	  Pegasus chips.

config CENTAUR_SPARE_SIZE
	hex "Spare size"
	depends on ARCH_MICREL_PEGASUS
	default "0x40000"
	help
	  This is the size of the spare space for other uses.

config CENTAUR_NAND_SIZE
	hex "NAND size"
	depends on ARCH_MICREL_PEGASUS
	default "0x2000000"
	help
	  This is the size of the NAND flash chip to use.

choice
	prompt "DDR memory types"
	depends on ARCH_KS8692P
	default MICRON_200_DDR

config SAMSUNG_166_DDR
	bool "Samsung 166 MHz DDR"
	help
	  Support for Samsung 166 MHz DDR chips.

config SAMSUNG_200_DDR
	bool "Samsung 200 MHz DDR"
	help
	  Support for Samsung 200 MHz DDR chips.

config MICRON_166_DDR
	bool "Micron 166 MHz DDR"
	help
	  Support for Micron 166 MHz DDR chips.

config MICRON_200_DDR
	bool "Micron 200 MHz DDR"
	help
	  Support for Micron 200 MHz DDR chips.
endchoice
```

## KSZ/kernels/linux-3.18/arch/arm/mach-ksz8695/Kconfig
```kconfig
choice
	prompt "Micrel Centaur Implementations"
	depends on ARCH_MICREL_CENTAUR
	default ARCH_KS8695P

config ARCH_KS8695X
	bool "KS8695X"
	select KS8695X
	help
	  Support for KS8695X Soho Router platforms.

config ARCH_KS8695P
	bool "KS8695P"
	select KS8695P
	help
	  Include support for KS8695P and KS8695P/X wireless Soho Router platforms.

config ARCH_KS8695PM
        bool "KS8695PM Mediabox"
	select KS8695P
	select KS8695M
        help
          Include support for KS8695PM Mediabox platforms.

config ARCH_KS8695MB
        bool "KS8695MB Mediabox"
	select KS8695P
	select KS8695M
        help
          Include support for KS8695MB Mediabox platforms.

config ARCH_KS8695V
        bool "KS8695PX VoIP"
	select KS8695P
        help
          Include support for KS8695PX VoIP platforms.

config ARCH_KS8695L
        bool "KS8695L"
	select KS8695X
        help
          Include support for KS8695L Soho Router platforms.

endchoice

choice
	prompt "KS8695PX VoIP Revisions"
	depends on ARCH_KS8695V
	default KS8695V1

config KS8695V0
	bool "KS8695V0"
	help
	  Support for 16-bit KS8695PX VoIP platforms.

config KS8695V1
	bool "KS8695V1"
	help
	  Support for 32-bit KS8695PX VoIP platforms.

config KS8695VS
	bool "KS8695VS"
	help
	  Support for 16-bit/32-bit KS8695PX VoIP platforms.
endchoice

config ARCH_KS8695S
	bool "KS8695P Special"
	default n
	depends on ARCH_KS8695P
	help
	  Support for special KS8695P Soho Router platforms.

config KS8695PG
	bool "KS8695P PCI Guest"
	default n
	depends on ARCH_KS8695P
	help
	  Support for KS8695P PCI Guest Mode.

config VOIP_4PORT
	bool "KS8695PX 4-port VoIP"
	default n
	depends on ARCH_KS8695P
	help
	  Support for KS8695PX with 4-port VoIP daughter board.

config KS884X_LOAD_BOARD
	bool "KS884X Load Board"
	default n
	depends on ARCH_KS8695X
	help
	  Support for KS884X Load Board.

config KS8695P
	bool
	help
	  KS8695P-based chip support.

config KS8695X
	bool
	help
	  KS8695X-based chip support.

config KS8695M
	bool
	help
	  KS8695P Mediabox support.

config DELAYED_TIMER
	bool "Enable delayed timer"
	default n
	depends on ARCH_MICREL_CENTAUR
	help
	  Enable microsecond timer for delayed tasks.

config U_BOOT_LOADER
	bool "Use U-Boot loader"
	default n
	depends on ARCH_MICREL_CENTAUR
	help
	  Use U-Boot loader instead of original Micrel bootloader.

config CENTAUR_LOADER_SIZE
	hex "Bootloader size"
	depends on ARCH_MICREL_CENTAUR
	default "0x10000"
	help
	  This is the maximum size of the bootloader for the Centaur
	  KS8695P/X chips.

config CENTAUR_KERNEL_SIZE
	hex "Kernel size"
	depends on ARCH_MICREL_CENTAUR
	default "0xE0000"
	help
	  This is the maximum size of the kernel for the Centaur
	  KS8695P/X chips.

config CENTAUR_FS_SIZE
	hex "Filesystem size"
	depends on ARCH_MICREL_CENTAUR
	default "0x60000"
	help
	  This is the size of the non-volatile filesystem for the
	  Centaur KS8695P/X chips.
```

## KSZ/kernels/linux-3.18/drivers/crypto/kszipsec/Kconfig
```kconfig
config CRYPTO_DEV_KSZIPSEC
	tristate "Pegasus IPsec driver"
	depends on CRYPTO && ARCH_MICREL_PEGASUS
	select CRYPTO_BLKCIPHER
	default y
	---help---
	  This is not an option for Micrel Pegasus KSZ8692 family.  Say Y
	  to include the IPsec driver in the kernel or M to load the
	  driver as a module.

config USE_KSZCRYPT
	bool "Use Pegasus crypto engine"
	depends on CRYPTO_DEV_KSZIPSEC
	default y
	help
	  Say Y here in order to use the Pegasus crypto engine.

config USE_KSZIPSEC
	bool "Use Pegasus IPsec code"
	depends on CRYPTO_DEV_KSZIPSEC
	default n
	help
	  Say Y here in order to use the Pegasus IPsec code.

config TEST_KSZIPSEC
	bool "Test Pegasus IPsec code"
	depends on CRYPTO_DEV_KSZIPSEC && !USE_KSZIPSEC
	help
	  Say Y here in order to test the Pegasus IPsec code.

config DEBUG_KSZIPSEC
	bool "Pegasus IPsec debug"
	depends on CRYPTO_DEV_KSZIPSEC
	help
	  Say Y here in order to have the Pegasus IPsec code generate
	  verbose debugging messages.

config SIM_IPSEC
	bool "Simulate IPsec for testing"
	depends on CRYPTO_DEV_KSZIPSEC
	help
	  Say Y here in order to create initial IPsec connections for
	  testing.
```
