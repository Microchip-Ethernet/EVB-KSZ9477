## KSZ/kernels/linux-4.9.143/drivers/net/ethernet/micrel/Kconfig
```kconfig
#
# Micrel device configuration
#

config NET_VENDOR_MICREL
	bool "Microchip/Micrel devices"
	default y
	depends on (HAS_IOMEM && DMA_ENGINE) || SPI || PCI || HAS_IOMEM || \
		   (ARM && ARCH_KS8695)
	---help---
	  If you have a network (Ethernet) card belonging to this class, say Y.

	  Note that the answer to this question doesn't directly affect the
	  kernel: saying N will just cause the configurator to skip all
	  the questions about Micrel devices. If you say Y, you will be asked
	  for your specific card in the following questions.

if NET_VENDOR_MICREL

config ARM_KS8695_ETHER
	tristate "KS8695 Ethernet support"
	depends on ARM && ARCH_KS8695
	select MII
	---help---
	  If you wish to compile a kernel for the KS8695 and want to
	  use the internal ethernet then you should answer Y to this.

config KS8842
	tristate "Micrel KSZ8841/42 with generic bus interface"
	depends on HAS_IOMEM && DMA_ENGINE
	---help---
	  This platform driver is for KSZ8841(1-port) / KS8842(2-port)
	  ethernet switch chip (managed, VLAN, QoS) from Micrel or
	  Timberdale(FPGA).

config KS8851
	tristate "Micrel KS8851 SPI"
	depends on SPI
	select MII
	select CRC32
	select EEPROM_93CX6
	---help---
	  SPI driver for Micrel KS8851 SPI attached network chip.

config KS8851_MLL
	tristate "Micrel KS8851 MLL"
	depends on HAS_IOMEM
	select MII
	---help---
	  This platform driver is for Micrel KS8851 Address/data bus
	  multiplexed network chip.

config KSZ884X_PCI
	tristate "Micrel KSZ8841/2 PCI"
	depends on PCI
	select MII
	select CRC32
	---help---
	  This PCI driver is for Micrel KSZ8841/KSZ8842 PCI Ethernet chip.

	  To compile this driver as a module, choose M here. The module
	  will be called ksz884x.

config KSZ8462_HLI
	tristate "Microchip KSZ8462/KSZ8441/KSZ8852 HLI support"
	depends on HAVE_KSZ8863 = n
	select MII
	select CRC32
	select EEPROM_93CX6
	help
	  This platform driver is for Microchip KSZ8462/KSZ8441/KSZ8852
	  address/data bus multiplexed network chip.

config KSZ_PTP
	bool "1588 PTP support"
	depends on KSZ8462_HLI || HAVE_KSZ8463 || HAVE_KSZ9897
	default y
	help
	  Enable 1588 PTP support.

config KSZ_STP
	bool "STP support"
	depends on KSZ8462_HLI || KSZ_SWITCH
	default y
	help
	  Enable STP support.

menuconfig KSZ_SWITCHES
	tristate "Drivers for Microchip KSZ switches"
	---help---
	  Supports Microchip KSZ switches.

if KSZ_SWITCHES

comment "Microchip KSZ switch device drivers"

config KSZ_SWITCH
	bool
	default n

config KSZ_SMI
	bool
	default n

config KSZ_SWITCH_EMBEDDED
	bool
	default n
	select KSZ_SWITCH

config HAVE_KSZ8463
	bool
	default n

config SPI_KSZ8463
	tristate "SPI driver for Microchip KSZ8463 switch"
	depends on HAVE_KSZ8863 = n
	select KSZ_SWITCH
	select HAVE_KSZ8463
	---help---
	  Supports the Microchip KSZ8463 switch.

config KSZ8463_EMBEDDED
	bool "Microchip KSZ8463 switch support in network controller"
	depends on HAVE_KSZ8863 = n
	depends on SPI_KSZ8463 = n
	select KSZ_SWITCH_EMBEDDED
	select HAVE_KSZ8463
	---help---
	  Supports the Microchip KSZ8463 switch used within a network controller.

config HAVE_KSZ8863
	bool
	default n

config I2C_KSZ8863
	tristate "I2C driver for Microchip KSZ8863 switch"
	select KSZ_SWITCH
	select HAVE_KSZ8863
	---help---
	  Supports the Microchip KSZ8863 switch in SPI mode.

config SPI_KSZ8863
	tristate "SPI driver for Microchip KSZ8863 switch"
	select KSZ_SWITCH
	select HAVE_KSZ8863
	---help---
	  Supports the Microchip KSZ8863 switch in I2C mode.

config KSZ8863_EMBEDDED
	bool "Microchip KSZ8863 switch support in network controller"
	depends on SPI_KSZ8863 = n
	select KSZ_SWITCH_EMBEDDED
	select HAVE_KSZ8863
	---help---
	  Supports the Microchip KSZ8863 switch used within a network controller.

config SMI_KSZ8863
	bool "SMI driver for Microchip KSZ8863 switch"
	depends on SPI_KSZ8863 = n && KSZ8863_EMBEDDED = n
	select KSZ_SWITCH_EMBEDDED
	select KSZ_SMI
	select HAVE_KSZ8863
	---help---
	  Supports the Microchip KSZ8863 switch in SMI mode.

config HAVE_KSZ8795
	bool
	default n

config SPI_KSZ8795
	tristate "SPI driver for Microchip KSZ8795 switch"
	select KSZ_SWITCH
	select HAVE_KSZ8795
	---help---
	  Supports the Microchip KSZ8795 switch.

config KSZ8795_EMBEDDED
	bool "Microchip KSZ8795 switch support in network controller"
	depends on SPI_KSZ8795 = n
	select KSZ_SWITCH_EMBEDDED
	select HAVE_KSZ8795
	---help---
	  Supports the Microchip KSZ8795 switch used within a network controller.

config HAVE_KSZ8895
	bool
	default n

config SPI_KSZ8895
	tristate "SPI driver for Microchip KSZ8895 switch"
	select KSZ_SWITCH
	select HAVE_KSZ8895
	---help---
	  Supports the Microchip KSZ8895 switch.

config KSZ8895_EMBEDDED
	bool "Microchip KSZ8895 switch support in network controller"
	depends on SPI_KSZ8895 = n
	select KSZ_SWITCH_EMBEDDED
	select HAVE_KSZ8895
	---help---
	  Supports the Microchip KSZ8895 switch used within a network controller.

config SMI_KSZ8895
	bool "SMI driver for Microchip KSZ8895 switch"
	depends on SPI_KSZ8895 = n && KSZ8895_EMBEDDED = n
	select KSZ_SWITCH_EMBEDDED
	select KSZ_SMI
	select HAVE_KSZ8895
	---help---
	  Supports the Microchip KSZ8895 switch in SMI mode.

config HAVE_KSZ9897
	bool
	default n

config I2C_KSZ9897
	tristate "I2C driver for Microchip KSZ9897 switch"
	select KSZ_SWITCH
	select HAVE_KSZ9897
	---help---
	  Supports the Microchip KSZ9897 switch.

config SPI_KSZ9897
	tristate "SPI driver for Microchip KSZ9897 switch"
	select KSZ_SWITCH
	select HAVE_KSZ9897
	---help---
	  Supports the Microchip KSZ9897 switch.

config KSZ9897_EMBEDDED
	bool "Microchip KSZ9897 switch support in network controller"
	depends on SPI_KSZ9897 = n
	select KSZ_SWITCH_EMBEDDED
	select HAVE_KSZ9897
	---help---
	  Supports the Microchip KSZ9897 switch used within a network controller.

config KSZ_IBA_ONLY
	bool "Microchip KSZ9897 switch with IBA support"
	depends on SPI_KSZ9897 = n
	select KSZ_SWITCH_EMBEDDED
	select KSZ_IBA
	select HAVE_KSZ9897
	---help---
	  Supports the Microchip KSZ9897 switch used within a network controller using IBA.

config KSZ_IBA
	bool "IBA support"
	depends on HAVE_KSZ9897
	default y
	help
	  Enable IBA support.

config KSZ_MRP
	bool "MRP support"
	depends on KSZ_SWITCH
	default y if (HAVE_KSZ9897)
	help
	  Enable MRP support.

config KSZ_MSRP
	bool "MSRP support"
	depends on (HAVE_KSZ9897) && KSZ_MRP
	default y
	help
	  Enable MSRP support.

config KSZ_MSTP
	bool "MSTP support"
	depends on HAVE_KSZ9897
	select KSZ_STP
	select CRYPTO_HMAC
	select CRYPTO_MD5
	default n
	help
	  Enable MSTP support.

config KSZ_DLR
	bool "DLR support"
	depends on (HAVE_KSZ9897 || HAVE_KSZ8795) && KSZ_SWITCH
	default y if (HAVE_KSZ9897)
	help
	  Enable DLR support.

config KSZ_HSR
	bool "HSR support"
	depends on (HAVE_KSZ9897) && KSZ_SWITCH
	default y if (HAVE_KSZ9897)
	help
	  Enable HSR support.

endif

endif # NET_VENDOR_MICREL
```

## KSZ/linux-drivers/dsa/latest/net/dsa/Kconfig.patch
```kconfig
--- Kconfig.orig	2015-05-29 00:22:57.000000000 -0700
+++ Kconfig	2015-06-19 13:08:03.541924420 -0700
@@ -24,4 +24,8 @@ config NET_DSA_TAG_EDSA
 config NET_DSA_TAG_TRAILER
 	bool
 
+config NET_DSA_TAG_TAIL
+	bool
+	select NET_DSA_TAG_TRAILER
+
 endif
```

## KSZ/linux-drivers/dsa/linux-4.19/drivers/net/dsa/microchip/Kconfig
```kconfig
config NET_DSA_MICROCHIP_KSZ_COMMON
	tristate

menuconfig NET_DSA_MICROCHIP_KSZ9477
	tristate "Microchip KSZ9477 series switch support"
	depends on NET_DSA
	select NET_DSA_TAG_KSZ
	select NET_DSA_MICROCHIP_KSZ_COMMON
	help
	  This driver adds support for Microchip KSZ9477 switch chips.

config NET_DSA_MICROCHIP_KSZ9477_I2C
	tristate "KSZ9477 series I2C connected switch driver"
	depends on NET_DSA_MICROCHIP_KSZ9477 && I2C
	default y
	help
	  Select to enable support for registering switches configured through I2C.

config NET_DSA_MICROCHIP_KSZ9477_SPI
	tristate "KSZ9477 series SPI connected switch driver"
	depends on NET_DSA_MICROCHIP_KSZ9477 && SPI
	default y
	help
	  Select to enable support for registering switches configured through SPI.

menuconfig NET_DSA_MICROCHIP_KSZ8795
	tristate "Microchip KSZ8795 series switch support"
	depends on NET_DSA
	select NET_DSA_TAG_KSZ
	select NET_DSA_MICROCHIP_KSZ_COMMON
	help
	  This driver adds support for Microchip KSZ8795 switch chips.

config NET_DSA_MICROCHIP_KSZ8795_SPI
	tristate "KSZ8795 series SPI connected switch driver"
	depends on NET_DSA_MICROCHIP_KSZ8795 && SPI
	default y
	help
	  This driver accesses KSZ8795 chip through SPI.

	  It is required to use the KSZ8795 switch driver as the only access
	  is through SPI.

menuconfig NET_DSA_MICROCHIP_KSZ8895
	tristate "Microchip KSZ8895 series switch support"
	depends on NET_DSA
	select NET_DSA_TAG_KSZ
	select NET_DSA_MICROCHIP_KSZ_COMMON
	help
	  This driver adds support for Microchip KSZ8895 switch chips.

config NET_DSA_MICROCHIP_KSZ8895_SPI
	tristate "KSZ8895 series SPI connected switch driver"
	depends on NET_DSA_MICROCHIP_KSZ8895 && SPI
	default y
	help
	  This driver accesses KSZ8895 chip through SPI.

	  It is required to use the KSZ8895 switch driver as the only access
	  is through SPI.

menuconfig NET_DSA_MICROCHIP_KSZ8863
	tristate "Microchip KSZ8863 series switch support"
	depends on NET_DSA
	select NET_DSA_TAG_KSZ
	select NET_DSA_MICROCHIP_KSZ_COMMON
	help
	  This driver adds support for Microchip KSZ8863 switch chips.

config NET_DSA_MICROCHIP_KSZ8863_I2C
	tristate "KSZ8863 series I2C connected switch driver"
	depends on NET_DSA_MICROCHIP_KSZ8863 && I2C
	default y
	help
	  This driver accesses KSZ8863 chip through I2C.

config NET_DSA_MICROCHIP_KSZ8863_SPI
	tristate "KSZ8863 series SPI connected switch driver"
	depends on NET_DSA_MICROCHIP_KSZ8863 && SPI
	default y
	help
	  This driver accesses KSZ8863 chip through SPI.

menuconfig NET_DSA_MICROCHIP_KSZ8463
	tristate "Microchip KSZ8463 series switch support"
	depends on NET_DSA
	select NET_DSA_TAG_KSZ
	select NET_DSA_MICROCHIP_KSZ_COMMON
	help
	  This driver adds support for Microchip KSZ8463 switch chips.

config NET_DSA_MICROCHIP_KSZ8463_SPI
	tristate "KSZ8463 series SPI connected switch driver"
	depends on NET_DSA_MICROCHIP_KSZ8463 && SPI
	default y
	help
	  This driver accesses KSZ8463 chip through SPI.

	  It is required to use the KSZ8463 switch driver as the only access
	  is through SPI.
```

## KSZ/linux-drivers/ksz8462/linux-3.3/drivers/net/ethernet/micrel/Kconfig
```kconfig
config KSZ8462_HLI
	tristate "Micrel KSZ8462/KSZ8441/KSZ8852 HLI support"
	select KSZ8462_HLI_EXT if ARCH_PEGASUS
	select NET_CORE
	select MII
	select CRC32
	select EEPROM_93CX6
	help
	  This platform driver is for Micrel KSZ8462/KSZ8441/KSZ8852
	  address/data bus multiplexed network chip.

config KSZ8462_HLI_PTP
	bool "1588 PTP support"
	depends on KSZ8462_HLI
	default y
	help
	  Enable 1588 PTP support.

config KSZ8462_HLI_STP
	bool "STP support"
	depends on KSZ8462_HLI
	default n
	help
	  Enable STP support.
```

## KSZ/linux-drivers/ksz8462/linux-4.9/drivers/net/ethernet/micrel/Kconfig
```kconfig
config KSZ8462_HLI
	tristate "Microchip KSZ8462/KSZ8441/KSZ8852 HLI support"
	select MII
	select CRC32
	select EEPROM_93CX6
	help
	  This platform driver is for Microchip KSZ8462/KSZ8441/KSZ8852
	  address/data bus multiplexed network chip.

config KSZ_PTP
	bool "1588 PTP support"
	depends on KSZ8462_HLI
	default y
	help
	  Enable 1588 PTP support.

config KSZ_STP
	bool "STP support"
	depends on KSZ8462_HLI
	default n
	help
	  Enable STP support.
```
