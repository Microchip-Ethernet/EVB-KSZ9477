
#if defined(CONFIG_KSZ8999)
static int sda_gpio_request(void)
{
	int ret;

	ret = gpio_request(KS_GPIO_6, "KSZ");
	if (ret)
		return ret;
	ret = gpio_request(KS_GPIO_7, "KSZ");
	if (ret) {
		gpio_free(KS_GPIO_6);
		return ret;
	}
	gpio_direction_output(KS_GPIO_6, 1);
	gpio_direction_output(KS_GPIO_7, 1);
	return 0;
}

static u8 reg[54] = {
	0x55, 0x99,
#if 0
	/* VLAN enforcement */
	0x03, 0xF0,
	/* insert tag, remove tag */
	0x25, 0x23, 0x23, 0x23, 0x23, 0x23, 0x23, 0x23, 0x23,
	/* VLAN membership */
	0xFF, 0x01, 0x01, 0x01, 0x01, 0x01, 0x01, 0x01, 0x01,
	/* VLAN tag */
	0x00, 0x00,
	0x00, 0x10,
	0x00, 0x10,
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	0x00, 0x00, 0x00, 0x00, 0x00, 0x00, 0x00, 0x18,
#else
	0x03, 0xF0,
	0x25, 0x25, 0x04, 0x04, 0x04, 0x04, 0x04, 0x04, 0x04,
	0xFF, 0xFF, 0xFF, 0xFF, 0xFF, 0xFF, 0xFF, 0xFF, 0xFF,
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	0x00, 0x00, 0x00, 0x00, 0x00, 0x00, 0x00, 0x00,
#endif
	0x00, 0x40, 0x05, 0x43, 0x5E, 0xFE
};

static void sda_setup(void)
{
	int i;
	int j;
	u8 byte;

	byte = reg[0];
	printk("%02x ", byte);
	j = 7;
	gpio_set_value(KS_GPIO_6, !!(byte & (1 << j)));
	do {
		--j;
		gpio_set_value(KS_GPIO_7, 0);
		gpio_set_value(KS_GPIO_6, !!(byte & (1 << j)));
		gpio_set_value(KS_GPIO_7, 1);
	} while (j > 0);
	i = 1;
	do {
		byte = reg[i];
		printk("%02x ", byte);
		j = 8;
		do {
			--j;
			gpio_set_value(KS_GPIO_7, 0);
			gpio_set_value(KS_GPIO_6, !!(byte & (1 << j)));
			gpio_set_value(KS_GPIO_7, 1);
		} while (j > 0);
	} while (++i < 54);
	printk("\n");
}

static int __init ksz8999_sda_init(void)
{
	int rc;

	rc = sda_gpio_request();
	if (!rc)
		sda_setup();
	return rc;
}
arch_initcall(ksz8999_sda_init);
#endif
