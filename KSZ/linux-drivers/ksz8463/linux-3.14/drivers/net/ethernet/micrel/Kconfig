## KSZ/linux-drivers/ksz8463/linux-3.14/drivers/net/ethernet/micrel/Kconfig
```kconfig
menuconfig MICREL_SWITCHES
	tristate "Drivers for Micrel switches"
	---help---
	  Supports Micrel switches.

if MICREL_SWITCHES

comment "Micrel switch device drivers"

config MICREL_SWITCH
	bool
	default n

config MICREL_SWITCH_EMBEDDED
	bool
	default n
	select MICREL_SWITCH

config HAVE_SPI_KSZ8463
	bool
	default n

config SPI_KSZ8463
	tristate "SPI driver for Micrel KSZ8463 switch"
	select MICREL_SWITCH if !NET_DSA_TAG_TAIL
	select HAVE_SPI_KSZ8463
	---help---
	  Supports the Micrel KSZ8463 switch.

config MICREL_KSZ8463_EMBEDDED
	bool "Micrel KSZ8463 switch support in network controller"
	depends on SPI_KSZ8463 = n && !NET_DSA_TAG_TAIL
	select MICREL_SWITCH_EMBEDDED
	select HAVE_SPI_KSZ8463
	---help---
	  Supports the Micrel KSZ8463 switch used with a network controller.

config MICREL_KSZ8463_PTP
	bool "1588 PTP support"
	depends on SPI_KSZ8463 || MICREL_KSZ8463_EMBEDDED
	default y
	help
	  Enable 1588 PTP support.

config MICREL_KSZ8463_STP
	bool "STP support"
	depends on SPI_KSZ8463 || MICREL_KSZ8463_EMBEDDED
	default n
	help
	  Enable STP support.

endif
```

## KSZ/linux-drivers/ksz8463/linux-3.18/drivers/net/ethernet/micrel/Kconfig
```kconfig
config KSZ_PTP
	bool "1588 PTP support"
	depends on HAVE_KSZ8463
	default y
	help
	  Enable 1588 PTP support.

config KSZ_STP
	bool "STP support"
	depends on KSZ_SWITCH
	default n
	help
	  Enable STP support.

menuconfig KSZ_SWITCHES
	tristate "Drivers for Microchip KSZ switches"
	---help---
	  Supports Microchip KSZ switches.

if KSZ_SWITCHES

comment "Microchip KSZ switch device drivers"

config KSZ_SWITCH
	bool
	default n

config KSZ_DSA
	bool
	default n

config KSZ_SWITCH_EMBEDDED
	bool
	default n
	select KSZ_SWITCH

config HAVE_KSZ8463
	bool
	default n

config HAVE_SPI_KSZ8463
	bool
	default n
	select HAVE_KSZ8463

config SPI_KSZ8463
	tristate "SPI driver for Microchip KSZ8463 switch"
	select KSZ_SWITCH if !NET_DSA_TAG_TAIL
	select KSZ_DSA if NET_DSA_TAG_TAIL
	select HAVE_SPI_KSZ8463
	---help---
	  Supports the Microchip KSZ8463 switch.

config KSZ8463_EMBEDDED
	bool "Microchip KSZ8463 switch support in network controller"
	depends on SPI_KSZ8463 = n && !NET_DSA_TAG_TAIL
	select KSZ_SWITCH_EMBEDDED
	select HAVE_SPI_KSZ8463
	---help---
	  Supports the Microchip KSZ8463 switch used within a network controller.

endif
```

## KSZ/linux-drivers/ksz8795/linux-3.18/drivers/net/ethernet/micrel/Kconfig
```kconfig
config KSZ_STP
	bool "STP support"
	depends on KSZ_SWITCH
	default y
	help
	  Enable STP support.

menuconfig KSZ_SWITCHES
	tristate "Drivers for Microchip KSZ switches"
	---help---
	  Supports Microchip KSZ switches.

if KSZ_SWITCHES

comment "Microchip KSZ switch device drivers"

config KSZ_SWITCH
	bool
	default n

config KSZ_DSA
	bool
	default n

config KSZ_SWITCH_EMBEDDED
	bool
	default n
	select KSZ_SWITCH

config HAVE_KSZ9897
	bool
	default n

config HAVE_KSZ8795
	bool
	default n

config HAVE_SPI_KSZ8795
	bool
	default n
	select HAVE_KSZ8795

config SPI_KSZ8795
	tristate "SPI driver for Microchip KSZ8795 switch"
	select KSZ_SWITCH if !NET_DSA_TAG_TAIL
	select KSZ_DSA if NET_DSA_TAG_TAIL
	select HAVE_SPI_KSZ8795
	---help---
	  Supports the Microchip KSZ8795 switch.

config KSZ8795_EMBEDDED
	bool "Microchip KSZ8795 switch support in network controller"
	depends on SPI_KSZ8795 = n && !NET_DSA_TAG_TAIL
	select KSZ_SWITCH_EMBEDDED
	select HAVE_SPI_KSZ8795
	---help---
	  Supports the Microchip KSZ8795 switch used within a network controller .

config KSZ_DLR
	bool "DLR support"
	depends on (HAVE_KSZ9897 || HAVE_KSZ8795) && KSZ_SWITCH
	default y if (HAVE_KSZ9897)
	help
	  Enable DLR support.

endif
```

## KSZ/linux-drivers/ksz8863/linux-3.3/drivers/net/ethernet/micrel/Kconfig
```kconfig
menuconfig MICREL_SWITCHES
	tristate "Drivers for Micrel switches"
	depends on SPI
	---help---
	  Supports Micrel switches.

if MICREL_SWITCHES

comment "Micrel switch device drivers"

config MICREL_SWITCH
	bool
	default n

config MICREL_SWITCH_EMBEDDED
	bool
	default n
	select MICREL_SWITCH

config HAVE_KSZ8863
	bool
	default n

config HAVE_SPI_KSZ8863
	bool
	default n
	select HAVE_KSZ8863

config SPI_KSZ8863
	tristate "SPI driver for Micrel KSZ8863 switch"
	select MICREL_SWITCH if !NET_DSA_TAG_TAIL
	select HAVE_SPI_KSZ8863
	---help---
	  Supports the Micrel KSZ8863 switch.

config I2C_KSZ8863
	tristate "I2C driver for Micrel KSZ8863 switch"
	select MICREL_SWITCH if !NET_DSA_TAG_TAIL
	select HAVE_KSZ8863
	---help---
	  Supports the Micrel KSZ8863 switch.

config MICREL_KSZ8863_EMBEDDED
	bool "Micrel KSZ8863 switch support in network controller"
	depends on I2C_KSZ8863 = n && SPI_KSZ8863 = n && !NET_DSA_TAG_TAIL
	select MICREL_SWITCH_EMBEDDED
	select HAVE_SPI_KSZ8863
	---help---
	  Supports the Micrel KSZ8863 switch used within a network controller.

config MICREL_KSZ8863_STP
	bool "STP support"
	depends on HAVE_KSZ8863
	default n
	help
	  Enable STP support.

endif
```

## KSZ/linux-drivers/ksz8863/linux-4.19/drivers/net/ethernet/micrel/Kconfig
```kconfig
config KSZ_STP
	bool "STP support"
	depends on KSZ_SWITCH
	default n
	help
	  Enable STP support.

menuconfig KSZ_SWITCHES
	tristate "Drivers for Microchip KSZ switches"
	---help---
	  Supports Microchip KSZ switches.

if KSZ_SWITCHES

comment "Microchip KSZ switch device drivers"

config KSZ_SWITCH
	bool
	default n

config KSZ_DSA
	bool
	default n

config KSZ_SWITCH_EMBEDDED
	bool
	default n
	select KSZ_SWITCH

config HAVE_KSZ8863
	bool
	default n

config HAVE_SPI_KSZ8863
	bool
	default n
	select HAVE_KSZ8863

config I2C_KSZ8863
	tristate "I2C driver for Microchip KSZ8863 switch"
	select KSZ_SWITCH if !NET_DSA_TAG_TAIL
	select KSZ_DSA if NET_DSA_TAG_TAIL
	select HAVE_KSZ8863
	---help---
	  Supports the Microchip KSZ8863 switch.

config SPI_KSZ8863
	tristate "SPI driver for Microchip KSZ8863 switch"
	select KSZ_SWITCH if !NET_DSA_TAG_TAIL
	select KSZ_DSA if NET_DSA_TAG_TAIL
	select HAVE_SPI_KSZ8863
	---help---
	  Supports the Microchip KSZ8863 switch.

config KSZ8863_EMBEDDED
	bool "Microchip KSZ8863 switch support in network controller"
	depends on I2C_KSZ8863 = n && SPI_KSZ8863 = n && !NET_DSA_TAG_TAIL
	select KSZ_SWITCH_EMBEDDED
	select HAVE_SPI_KSZ8863
	---help---
	  Supports the Microchip KSZ8863 switch used within a network controller.

endif
```

## KSZ/linux-drivers/ksz8895/linux-3.3/drivers/net/ethernet/micrel/Kconfig
```kconfig
menuconfig MICREL_SWITCHES
	tristate "Drivers for Micrel switches"
	---help---
	  Supports Micrel switches.

if MICREL_SWITCHES

comment "Micrel switch device drivers"

config MICREL_SWITCH
	bool
	default n

config MICREL_SWITCH_EMBEDDED
	bool
	default n
	select MICREL_SWITCH

config HAVE_KSZ8895
	bool
	default n

config HAVE_SPI_KSZ8895
	bool
	default n
	select HAVE_KSZ8895

config SPI_KSZ8895
	tristate "SPI driver for Micrel KSZ8895 switch"
	select MICREL_SWITCH if !NET_DSA_TAG_TAIL
	select HAVE_SPI_KSZ8895
	---help---
	  Supports the Micrel KSZ8895 switch.

config MICREL_KSZ8895_STP
	bool "STP support"
	depends on HAVE_KSZ8895
	default n
	help
	  Enable STP support.

endif
```

## KSZ/linux-drivers/ksz8895/linux-4.14/drivers/net/ethernet/micrel/Kconfig
```kconfig
config KSZ_STP
	bool "STP support"
	depends on KSZ_SWITCH
	default y
	help
	  Enable STP support.

menuconfig KSZ_SWITCHES
	tristate "Drivers for Microchip KSZ switches"
	---help---
	  Supports Microchip KSZ switches.

if KSZ_SWITCHES

comment "Microchip KSZ switch device drivers"

config KSZ_SWITCH
	bool
	default n

config KSZ_DSA
	bool
	default n

config KSZ_SWITCH_EMBEDDED
	bool
	default n
	select KSZ_SWITCH

config HAVE_KSZ8895
	bool
	default n

config HAVE_SPI_KSZ8895
	bool
	default n
	select HAVE_KSZ8895

config SPI_KSZ8895
	tristate "SPI driver for Microchip KSZ8895 switch"
	select KSZ_SWITCH if !NET_DSA_TAG_TAIL
	select KSZ_DSA if NET_DSA_TAG_TAIL
	select HAVE_SPI_KSZ8895
	---help---
	  Supports the Microchip KSZ8895 switch.

config KSZ8895_EMBEDDED
	bool "Microchip KSZ8895 switch support in network controller"
	depends on SPI_KSZ8895 = n && !NET_DSA_TAG_TAIL
	select KSZ_SWITCH_EMBEDDED
	select HAVE_SPI_KSZ8895
	---help---
	  Supports the Microchip KSZ8895 switch used within a network controller .

endif
```

## KSZ/linux-drivers/ksz9897/linux-3.14/drivers/net/ethernet/micrel/Kconfig
```kconfig
menuconfig MICREL_SWITCHES
	tristate "Drivers for Micrel switches"
	---help---
	  Supports Micrel switches.

if MICREL_SWITCHES

comment "Micrel switch device drivers"

config MICREL_SWITCH
	bool
	default n

config MICREL_SWITCH_EMBEDDED
	bool
	default n
	select MICREL_SWITCH

config HAVE_KSZ9897
	bool
	default n

config HAVE_SPI_KSZ9897
	bool
	default n
	select HAVE_KSZ9897

config I2C_KSZ9897
	tristate "I2C driver for Micrel KSZ9897 switch"
	select MICREL_SWITCH if !NET_DSA_TAG_TAIL
	select HAVE_KSZ9897
	---help---
	  Supports the Micrel KSZ9897 switch.

config SPI_KSZ9897
	tristate "SPI driver for Micrel KSZ9897 switch"
	select MICREL_SWITCH if !NET_DSA_TAG_TAIL
	select HAVE_SPI_KSZ9897
	---help---
	  Supports the Micrel KSZ9897 switch.

config MICREL_KSZ9897_EMBEDDED
	bool "Micrel KSZ9897 switch support in network controller"
	depends on SPI_KSZ9897 = n && !NET_DSA_TAG_TAIL
	select MICREL_SWITCH_EMBEDDED
	select HAVE_SPI_KSZ9897
	---help---
	  Supports the Micrel KSZ9897 switch used within a network controller.

config MICREL_KSZ9897_PTP
	bool "1588 PTP support"
	depends on HAVE_KSZ9897
	default y
	help
	  Enable 1588 PTP support.

config MICREL_KSZ9897_STP
	bool "STP support"
	depends on HAVE_KSZ9897
	default n
	help
	  Enable STP support.

endif
```

## KSZ/linux-drivers/ksz9897/linux-4.19/drivers/net/ethernet/micrel/Kconfig
```kconfig
config KSZ_PTP
	bool "1588 PTP support"
	depends on KSZ8462_HLI || HAVE_KSZ8463 || HAVE_KSZ9897
	default y
	help
	  Enable 1588 PTP support.

config KSZ_STP
	bool "STP support"
	depends on KSZ8462_HLI || KSZ_SWITCH
	default y
	help
	  Enable STP support.

menuconfig KSZ_SWITCHES
	tristate "Drivers for Microchip KSZ switches"
	---help---
	  Supports Microchip KSZ switches.

if KSZ_SWITCHES

comment "Microchip KSZ switch device drivers"

config KSZ_SWITCH
	bool
	default n

config KSZ_SWITCH_EMBEDDED
	bool
	default n
	select KSZ_SWITCH

config HAVE_KSZ9897
	bool
	default n

config I2C_KSZ9897
	tristate "I2C driver for Microchip KSZ9897 switch"
	select KSZ_SWITCH
	select HAVE_KSZ9897
	---help---
	  Supports the Microchip KSZ9897 switch in I2C mode.

config SPI_KSZ9897
	tristate "SPI driver for Microchip KSZ9897 switch"
	select KSZ_SWITCH
	select HAVE_KSZ9897
	---help---
	  Supports the Microchip KSZ9897 switch in SPI mode.

config IBA_KSZ9897
	bool "IBA driver for Microchip KSZ9897 switch"
	depends on I2C_KSZ9897 = n && SPI_KSZ9897 = n
	select KSZ_SWITCH_EMBEDDED
	select KSZ_IBA
	select HAVE_KSZ9897
	---help---
	  Supports the Microchip KSZ9897 switch in IBA mode.

config KSZ_IBA
	bool "IBA support"
	depends on HAVE_KSZ9897
	default y
	help
	  Enable IBA support.

config KSZ_AVB
	bool "AVB support"
	depends on HAVE_KSZ9897
	default y
	help
	  Enable AVB support.

config KSZ_MRP
	bool "MRP support"
	depends on KSZ_SWITCH
	default y if (HAVE_KSZ9897)
	help
	  Enable MRP support.

config KSZ_MSRP
	bool "MSRP support"
	depends on KSZ_MRP && KSZ_AVB
	default y
	help
	  Enable MSRP support.

config KSZ_DLR
	bool "DLR support"
	depends on (HAVE_KSZ9897 || HAVE_KSZ8795) && KSZ_SWITCH
	default y if (HAVE_KSZ9897)
	help
	  Enable DLR support.

config KSZ_HSR
	bool "HSR support"
	depends on (HAVE_KSZ9897) && KSZ_SWITCH
	default y if (HAVE_KSZ9897)
	help
	  Enable HSR support.

endif
```

## KSZ/linux-drivers/ksz9897/linux-4.9/drivers/net/ethernet/micrel/Kconfig
```kconfig
config KSZ_PTP
	bool "1588 PTP support"
	depends on KSZ8462_HLI || HAVE_KSZ8463 || HAVE_KSZ9897
	default y
	help
	  Enable 1588 PTP support.

config KSZ_STP
	bool "STP support"
	depends on KSZ8462_HLI || KSZ_SWITCH
	default y
	help
	  Enable STP support.

menuconfig KSZ_SWITCHES
	tristate "Drivers for Microchip KSZ switches"
	---help---
	  Supports Microchip KSZ switches.

if KSZ_SWITCHES

comment "Microchip KSZ switch device drivers"

config KSZ_SWITCH
	bool
	default n

config KSZ_DSA
	bool
	default n

config KSZ_SWITCH_EMBEDDED
	bool
	default n
	select KSZ_SWITCH

config HAVE_KSZ9897
	bool
	default n

config HAVE_SPI_KSZ9897
	bool
	default n
	select HAVE_KSZ9897

config I2C_KSZ9897
	tristate "I2C driver for Microchip KSZ9897 switch"
	select KSZ_SWITCH if !NET_DSA_TAG_TAIL
	select KSZ_DSA if NET_DSA_TAG_TAIL
	select HAVE_KSZ9897
	---help---
	  Supports the Microchip KSZ9897 switch.

config SPI_KSZ9897
	tristate "SPI driver for Microchip KSZ9897 switch"
	select KSZ_SWITCH if !NET_DSA_TAG_TAIL
	select KSZ_DSA if NET_DSA_TAG_TAIL
	select HAVE_SPI_KSZ9897
	---help---
	  Supports the Microchip KSZ9897 switch.

config KSZ9897_EMBEDDED
	bool "Microchip KSZ9897 switch support in network controller"
	depends on SPI_KSZ9897 = n && !NET_DSA_TAG_TAIL
	select KSZ_SWITCH_EMBEDDED
	select HAVE_SPI_KSZ9897
	---help---
	  Supports the Microchip KSZ9897 switch used within a network controller.

config KSZ_IBA_ONLY
	bool "Microchip KSZ9897 switch with IBA support"
	depends on SPI_KSZ9897 = n && !NET_DSA_TAG_TAIL
	select KSZ_SWITCH_EMBEDDED
	select KSZ_IBA
	select HAVE_KSZ9897
	---help---
	  Supports the Microchip KSZ9897 switch used within a network controller using IBA.

config KSZ_IBA
	bool "IBA support"
	depends on HAVE_KSZ9897
	default y
	help
	  Enable IBA support.

config KSZ_MRP
	bool "MRP support"
	depends on KSZ_SWITCH
	default y if (HAVE_KSZ9897)
	help
	  Enable MRP support.

config KSZ_MSRP
	bool "MSRP support"
	depends on (HAVE_KSZ9897) && KSZ_MRP
	default y
	help
	  Enable MSRP support.

config KSZ_DLR
	bool "DLR support"
	depends on (HAVE_KSZ9897 || HAVE_KSZ8795) && KSZ_SWITCH
	default y if (HAVE_KSZ9897)
	help
	  Enable DLR support.

config KSZ_HSR
	bool "HSR support"
	depends on (HAVE_KSZ9897) && KSZ_SWITCH
	default y if (HAVE_KSZ9897)
	help
	  Enable HSR support.

endif
```
